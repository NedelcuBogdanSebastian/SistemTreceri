/*************************************************************************************
    Copyright (C) 2024 Nedelcu Bogdan Sebastian
    This code is free software: you can redistribute it and/or modify it 
    under the following conditions:
    1. The use, distribution, and modification of this file are permitted for any 
       purpose, provided that the following conditions are met:
    2. Any redistribution or modification of this file must retain the original 
       copyright notice, this list of conditions, and the following attribution:
       "Original work by Nedelcu Bogdan Sebastian."
    3. The original author provides no warranty regarding the functionality or fitness 
       of this software for any particular purpose. Use it at your own risk.
    By using this software, you agree to retain the name of the original author in any 
    derivative works or distributions.
    ------------------------------------------------------------------------
    This code is provided as-is, without any express or implied warranties.
**************************************************************************************/

/*
 * Here we generate sine waves with phases from 0 to 359 degrees.
 * We add noise to each signal and compute the phase angle from FFT.
 * We then print over USB SERIAL the initial signal phase and
 * the computed phase to further analyze with Python if needed.
 * It appears on the PC as a USB SERIAL device, and we can use Termite
 * to see the values.
 *
 * The values are scaled by a factor of 10000!
 */

#include "stm32f10x.h"
#include "math.h"
#include "string.h"
#include "stdlib.h"
#include "stdio.h"
#include "hw_config.h"
#include "usb_lib.h"
#include "usb_desc.h"
#include "usb_pwr.h"

// Flattop Window: If the purpose of the test focus more on the energy value of a
// certain periodic signal frequency point. For example for Upeak, Upeak-peak, Urms,
// then the accuracy of its amplitude is more important, and a window with slighty
// wider lobes is better.
// The Flat Top window has a flatter passband, which helps retain accurate amplitude
// and phase information, particularly when analyzing signals where frequency peaks
// must be well-isolated. Since the window decreases the leakage, the phase extraction
// becomes more accurate. However, keep in mind that this window broadens the peaks,
// so you might sacrifice some resolution in the frequency domain.
/*void generate_flat_top_window(float *window, size_t num_points) {
    // Flat Top window coefficients
    const float a0 = 1.0;
    const float a1 = 1.93;
    const float a2 = 1.29;
    const float a3 = 0.388;
    const float a4 = 0.028;

    for (size_t n = 0; n < num_points; n++) {
        // Compute the normalized index value
        float factor = (2 * PI * n) / (num_points - 1);

        // Apply the Flat Top window function
        window[n] = a0
                  - a1 * cos(factor)
                  + a2 * cos(2 * factor)
                  - a3 * cos(3 * factor)
                  + a4 * cos(4 * factor);
    }
}
*/
const float flattop_window[] = {
0.000000, -0.000001, -0.000004, -0.000008, -0.000014, -0.000022, -0.000032, -0.000043,
-0.000056, -0.000071, -0.000088, -0.000106, -0.000127, -0.000149, -0.000173, -0.000198,
-0.000226, -0.000255, -0.000286, -0.000319, -0.000354, -0.000390, -0.000429, -0.000469,
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-0.000043, -0.000032, -0.000022, -0.000014, -0.000008, -0.000004, -0.000001, 0.000000
};

// FFT buffer
float signal[4096];

// Phases of the signal
float signal_phase = 0;

volatile uint32_t TimingDelay;

//  USB related
volatile uint8_t TestBuffer[27];
extern volatile uint8_t Receive_Buffer[64];
extern volatile uint32_t Receive_length ;
extern volatile uint32_t length ;
uint8_t Send_Buffer[64];
uint32_t packet_sent=1;
uint32_t packet_receive=1;

void Delay(volatile uint32_t nTime) {
    TimingDelay = nTime;
    while(TimingDelay != 0);
}

#define PI        3.1415926535897932384626433832795
#define DEG2RAD   0.01745329251994329576923690768489
#define RAD2DEG   57.295779513082320876798154814105  // 180/PI
#define EPSILON   1e-8 // Small value for zero comparison

// Calculates the FFT phase at a given frequency index.
// Input: data is complex FFT Re[V(0)],Im[V(0)], Re[V(1)],Im[V(1)],...
// Input: nn is the number of points in the data and in the FFT,
//           nn must be a power of 2
// Input: k is frequency index 0 to nn/2-1
//        E.g., if nn = 4096, then k can be 0 to 2047
// Output: Phase at this frequency
// data is an array of 2*nn elements
// returns 0 if k >= nn/2
float myfftPhase (float data[], unsigned long nn, uint16_t k) {
    if (k >= nn / 2) {
        return 0.0; // out of range
    }

    // Extract the real and imaginary parts of the k-th element
    float real_part = data[2 * k];
    float imag_part = data[2 * k + 1];

    // Handle the case when both real and imaginary parts are zero (undefined phase)
    if (fabs(real_part) < EPSILON && fabs(imag_part) < EPSILON) {
        return 0.0; // phase is undefined
    }

    // Calculate the angle in radians using atan2
    float angle_rad = atan2(imag_part, real_part);

    // Convert the angle to degrees
    float angle_deg = angle_rad * RAD2DEG;

    angle_deg -= 222.884444;

    // Normalize the angle to be in the range [0, 360)
    if (angle_deg < 0) {
        angle_deg += 360.0;
    }

    // Adjust phase based on phase difference between bin 9 an 50 Hz
    // ( Value is not equal to theory, like always :))) )
    //angle_deg = fmodf((angle_deg - 222.884444), 360.0);

    // Normalize the angle to be in the range [0, 360)
    if (angle_deg < 0) {
        angle_deg += 360.0;
    }

    return angle_deg;
}

// Apply the Flat Top window to the signal
void apply_flattop_window(float *signal, const float *flattop_window, uint16_t num_points) {
    for (size_t n = 0; n < num_points; n++) {
        signal[n * 2] = signal[n * 2] * flattop_window[n]; // Apply the window to the real part
    }
}

// Helper macro to swap two float values
#define SWAP(a, b) { float temp = (a); (a) = (b); (b) = temp; }

// FFT optimized for a signal array only with real side values, no imaginary
// Input: nn is the number of points in the data and in the FFT (must be a power of 2).
// Input: data is an array of nn real elements (no imaginary part initially, from ADC)
//        Re(0),0,Re(1),0,Re(2),...Re(nn-1),0
// Output: data will be transformed to contain complex FFT coefficients where the real
//         and imaginary parts are interleaved in the same array (Re, Im, Re, Im...).
void real_fft (float data[], unsigned long nn) {
    unsigned long n, mmax, m, j, istep, i;
    double wtemp, wr, wpr, wpi, wi, theta;
    double tempr, tempi;

    // `nn` is the number of real samples. In the complex FFT,
    // `n` will be twice `nn` because each complex number has two parts (Re and Im).
    n = nn << 1;  // n = 2 * nn, for real + imaginary storage (even though input is real, output will be complex)

    // ---- Bit-reversal Reordering ----
    // The FFT requires the input to be in bit-reversed order to optimize
    // in-place computation. Here we rearrange the data in such order.
    j = 1;
    for (i = 1; i < n; i += 2) {
        if (j > i) {  // Swap only if j > i to avoid swapping elements back
            SWAP(data[j-1], data[i-1]);  // Swap the real part
            SWAP(data[j], data[i]);      // Swap the imaginary part (initially 0)
        }

        // Bit-reversal logic (this shifts the bits around in a specific way
        // to reorder the data).
        m = n >> 1;
        while (m >= 2 && j > m) {
            j -= m;
            m >>= 1;
        }
        j += m;
    }

    // ---- Danielson-Lanczos Recursion ----
    // This is the heart of the FFT algorithm, where the computation is performed
    // in a recursive, divide-and-conquer manner.
    mmax = 2;  // mmax starts at 2 (which means we first handle 2-element blocks)
    while (n > mmax) {
        istep = mmax << 1;  // Step size for each FFT recursion level (block size)

        // Calculate the angle (theta) for the trigonometric recurrence relation
        // that is used to compute the FFT (twiddle factors).
        theta = -2.0 * PI / mmax;
        wtemp = sin(0.5 * theta);
        wpr = -2.0 * wtemp * wtemp;  // Real part of twiddle factor
        wpi = sin(theta);            // Imaginary part of twiddle factor
        wr = 1.0;                    // Starting value for twiddle real part (cos(0) = 1)
        wi = 0.0;                    // Starting value for twiddle imaginary part (sin(0) = 0)

        // For each recursion level, we loop through the data in chunks
        // of size `mmax`, computing the FFT step for each pair of elements.
        for (m = 1; m < mmax; m += 2) {
            for (i = m; i <= n; i += istep) {
                // The FFT is performed in pairs of elements. We compute the
                // real and imaginary parts of these elements and apply the twiddle factors.
                j = i + mmax;  // This is the other element in the pair

                // Calculate the real and imaginary components of the twiddle factor for this step
                tempr = wr * data[j-1] - wi * data[j];
                tempi = wr * data[j] + wi * data[j-1];

                // Update the real and imaginary parts with the calculated values
                data[j-1] = data[i-1] - tempr;
                data[j]   = data[i]   - tempi;
                data[i-1] = data[i-1] + tempr;
                data[i]   = data[i]   + tempi;
            }

            // Update the twiddle factors for the next iteration. This is done
            // using the recurrence relation for trigonometric functions.
            wtemp = wr;
            wr = wr * wpr - wi * wpi + wr;
            wi = wi * wpr + wtemp * wpi + wi;
        }

        // Double the block size for the next level of recursion.
        mmax = istep;
    }
}

// Adjust the phase to be an integer with `2 decimals` ( * 100)
uint16_t adjust_phase(float phase, float phase_difference) {
    // If phase difference it to big something is broken
    if (phase_difference >= 359.0)  // THE DWT TICKS COUNTER HAS GONE WHILD ON US !!! :)
        return 0;

    // Subtract the small delay from the moment we had zero-cross impulse
    // till the moment the ADC had first data ready (/DRA high)
    float adjusted_phase = phase - phase_difference;

    // Ensure the result is in the range [0, 360)
    if (adjusted_phase < 0) {
        adjusted_phase += 360.0;
    }

    // Scale by 100 and return as an integer. We keep two decimals of precision
    return (uint16_t)(adjusted_phase * 100.0);
}

// Adjust the voltage so that we have current only in 0..100 mA
uint16_t adjust_voltage (float voltage) {
    uint16_t voltage_value = 0;

    // Prevent negative values
    if (voltage < 0)
        return 0;

    // Scale by 10000 and convert to integer
    // The ADC `sees` voltage up to 0.6V without degraded precision
    voltage_value = (uint16_t)(voltage * 10000.0);

    // Top voltage at 100 mA (0.1 A * 5.6 OHM = 0.56 V * 10000.0 = 5600)
    if (voltage_value > 5600)
        return 5600;

    return voltage_value;
}

// Generate sine wave of specific phase and amplitude, with added noise
void generate_sine_wave(float *signal, uint16_t num_points, float rms_amplitude, float frequency, float sample_rate, float phase_degrees, float noise_amplitude) {
    // Convert phase from degrees to radians
    float phase_radians = phase_degrees * (PI / 180.0);

    // Calculate peak amplitude from RMS
    float peak_amplitude = rms_amplitude * sqrt(2.0);

    int k = 0;
    for (uint16_t i = 0; i < num_points * 2; i += 2) {
        // Calculate time based on sample rate
        float time = (float)k / sample_rate;

        // Generate sine wave value with phase
        // Real part
        float sine_value = peak_amplitude * sin(2.0 * PI * frequency * time + phase_radians);

        // Add noise to the sine wave value
        float noise = ((float)rand() / RAND_MAX) * 2.0f * noise_amplitude - noise_amplitude; // Noise in range [-noise_amplitude, noise_amplitude]

        signal[i] = sine_value + noise; // Add noise to the sine wave

        // Imaginary part
        signal[i + 1] = 0.0;

        k += 1;
    }
}

void print2usb(char *s) {
    if (s == NULL) {
        return; // Handle null pointer
    }

    int str_len = strlen(s); // Get the length of the string
    CDC_Send_DATA((unsigned char*)s, str_len); // Send the string to USB
    Delay(10);
}

void print2usb_int(uint32_t number) {
    // Buffer to hold the string representation of the integer
    char buffer[12]; // Enough for a 64-bit integer including sign
    char *ptr = buffer; // Pointer to traverse the buffer

    // Handle negative values
    if (number < 0) {
        *ptr++ = '-';
        number = -number; // Convert to positive for further processing
    }

    // Build the string in reverse
    if (number == 0) {
        *ptr++ = '0'; // Handle zero explicitly
    } else {
        // Convert integer to string
        int i = 0; // Index for digits
        while (number > 0) {
            buffer[i++] = '0' + (number % 10); // Get the last digit
            number /= 10; // Remove the last digit
        }

        // Reverse the digits in the buffer
        for (int j = 0; j < i / 2; j++) {
            char temp = buffer[j];
            buffer[j] = buffer[i - 1 - j];
            buffer[i - 1 - j] = temp;
        }
        ptr = buffer + i; // Update ptr to point to the end of the digits
    }

    // Null-terminate the string
    *ptr = '\0';

    // Send the constructed string over USB
    CDC_Send_DATA((unsigned char*)buffer, strlen(buffer));
    Delay(10);
}

int main(void) {
    GPIO_InitTypeDef GPIO_InitStructure;

    /************************************************************
    *   Set the Vector Table base adress at 0x8004000
    *************************************************************/
    NVIC_SetVectorTable(NVIC_VectTab_FLASH, 0x4000);

    // Set Systick to 1 ms interrupt (72 MHz clock)
    if(SysTick_Config(72000))
    {
        /* Capture error */
        while (1);
    }

    /************************************************************
    *   init PB0 led
    *************************************************************/
    RCC_APB2PeriphClockCmd(RCC_APB2Periph_GPIOB , ENABLE);
    GPIO_StructInit(&GPIO_InitStructure);
    GPIO_InitStructure.GPIO_Pin = GPIO_Pin_1 | GPIO_Pin_0;
    GPIO_InitStructure.GPIO_Speed = GPIO_Speed_50MHz;
    GPIO_InitStructure.GPIO_Mode = GPIO_Mode_Out_PP;
    GPIO_Init(GPIOB, &GPIO_InitStructure);

    /*************************************************************
    *   Init USB peripheral
    *************************************************************/
    Set_System();
    Set_USBClock();
    USB_Interrupts_Config();
    USB_Init();

    // Small delay so the user can open the new COM port in Termite 
    Delay(3000);

    const uint16_t num_points = 2048;    // Number of points in the buffer
    const float rms_amplitude = 0.025;   // RMS amplitude in volts
    const float frequency = 50.0;        // Frequency in Hz
    const float sample_rate = 11718.75;  // Sample rate in Hz (calculated to get index 9)
    float signal_phase = 0.0;
    float noise_aplitude = 0.002;

    while (signal_phase < 360.0) {
        // Generate the sine wave
        generate_sine_wave(signal, num_points, rms_amplitude, frequency, sample_rate, signal_phase, noise_aplitude);
        // Apply Flat Top window to the signal
        apply_flattop_window(signal, flattop_window, num_points);
        // Compute FFT
        real_fft(signal, 2048);
        // Compute signal phase
        float phase = myfftPhase(signal, 2048, 9);

        // Multiply by 10000 and convert to integer
        uint32_t sp = signal_phase * 10000.0;
        uint32_t p = phase * 10000.0;

        print2usb("\nPhase of signal:");
        print2usb_int(sp);
        print2usb(",Computed phase:");
        print2usb_int(p);

        // Toggle led
        GPIOB->ODR ^= GPIO_Pin_0;

        signal_phase += 2.5;
    }
}

/*
// If we need to store signed values we use 2's complement
// int16_t val = -100;
// uint16_t number = (uint16_t) val


#define TO_HEX(i) (i <= 9 ? '0' + i : 'A' - 10 + i)

void USBSERIAL_Print_Hex(uint16_t x)
{
    uint8_t res[5];

    if (x <= 0xFFFF)
    {
        res[0] = TO_HEX(((x & 0xF000) >> 12));
        res[1] = TO_HEX(((x & 0x0F00) >> 8));
        res[2] = TO_HEX(((x & 0x00F0) >> 4));
        res[3] = TO_HEX((x & 0x000F));
        res[4] = '\n';
    }
    CDC_Send_DATA ((uint8_t *)res,5);
}
*/
